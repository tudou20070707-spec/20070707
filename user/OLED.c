#include "OLED.h"
#include "MPU6050.h"                   // 需要 MPU6050_Data 结构体定义

/* ===================================================================
 *                SSD1306 OLED 显示屏驱动文件
 * ===================================================================
 * 本文件实现通过 STM32F103 的 I2C1 硬件外设驱动 0.96 寸 OLED 屏。
 *
 * 【I2C 总线共享架构】
 *   I2C1 总线上挂载两个从设备:
 *     MPU6050  — 设备地址 0xD0, 用于读取加速度/陀螺仪数据
 *     SSD1306  — 设备地址 0x78, 用于驱动 OLED 显示
 *   主机通过不同的设备地址区分与谁通信，互不干扰。
 *
 * 【SSD1306 与 MPU6050 通信方式的重要区别】
 *   MPU6050:
 *     发完设备地址后，第二字节是"寄存器地址"（如 0x3B）
 *     因为 MPU6050 内部有上百个寄存器，需要地址来定位。
 *
 *   SSD1306 (OLED):
 *     发完设备地址后，紧跟的是"控制字节"（0x00=命令, 0x40=数据）
 *     而不是寄存器地址！SSD1306 内部没有"寄存器地址"这个概念，
 *     它靠控制字节来区分: 接下来的字节是命令还是显示数据。
 *
 *   类比: MPU6050 是"按房间号存取"（寄存器地址），
 *         SSD1306 是"你说命令还是数据就行"（控制字节）。
 *
 * 【SSD1306 显示原理】
 *   芯片内部有一块 GDDRAM (Graphic Display Data RAM)，共 128×64 = 1024 字节
 *   每个 bit 对应屏幕上一个像素点: 1 = 亮, 0 = 灭
 *
 *   GDDRAM 按"页"组织:
 *     Page 0: 第 0~7   行像素 (对应 Y 坐标 0~7)
 *     Page 1: 第 8~15  行像素
 *     ...
 *     Page 7: 第 56~63 行像素
 *
 *   同一页内，列地址 0~127 对应 X 坐标的 128 列
 *
 *   写入一页的一列 = 1 字节 = 控制该列竖直方向 8 个像素的亮灭
 *   每个字节的 bit0 在最上面, bit7 在最下面:
 *
 *         列地址 0    列地址 1    ...  列地址 127
 *       ┌──────────┬──────────┬─────┬──────────┐
 *       │  bit0    │          │     │          │  ← Y=0
 *       │  bit1    │          │     │          │  ← Y=1
 *   P0  │  ...     │  一个字  │     │          │
 *       │  bit7    │  节搞定  │     │          │  ← Y=7
 *       ├──────────┼──────────┼─────┼──────────┤
 *   P1  │          │          │     │          │  ← Y=8~15
 *       ├──────────┼──────────┼─────┼──────────┤
 *   ...
 *       ├──────────┼──────────┼─────┼──────────┤
 *   P7  │          │          │     │          │  ← Y=56~63
 *       └──────────┴──────────┴─────┴──────────┘
 *
 * =================================================================== */

/* ============================================================
 * 内部辅助函数声明
 * ============================================================ */
static void OLED_WriteCmd(uint8_t cmd);                         // 发送一个命令字节
static void OLED_WriteData(const uint8_t *pData, uint8_t len);  // 发送多个数据字节
static void OLED_SetCursor(uint8_t page, uint8_t col);          // 设置光标位置

/* ============================================================
 * 显示缓冲区 (1024 字节 = 128列 × 8页)
 * ------------------------------------------------------------
 * 【为什么需要缓冲区？】
 *   如果每次写字符都直接发 I2C 到 OLED，屏幕会逐行刷新，
 *   肉眼能看到明显的闪烁和撕裂。
 *
 *   使用缓冲区后:
 *     1. 所有绘制函数 (ShowChar, Clear 等) 只修改缓冲区 (SRAM)
 *     2. 调用 OLED_Refresh() 时，一次性把 1024 字节推到 OLED
 *     3. 屏幕更新在 ~10ms 内完成，肉眼看不到闪烁
 *
 * 【缓冲区布局】
 *   OLED_Buffer[page][col]
 *     page: 0~7  (8 页, 每页高 8 像素)
 *     col:  0~127 (128 列)
 *     每个字节的 8 个 bit 对应该列 8 个像素的亮灭
 *
 * 【内存开销】
 *   128 × 8 = 1024 字节
 *   STM32F103C8T6 有 20KB SRAM，完全够用 (仅占 5%)
 * ============================================================ */
static uint8_t OLED_Buffer[OLED_PAGES][OLED_WIDTH];

/*
 * ============================================================
 * 8×16 ASCII 点阵字库
 * ------------------------------------------------------------
 * 包含 ASCII 码 32 (' ') ~ 126 ('~')，共 95 个可打印字符
 * 每个字符 16 字节 (8 像素宽 × 16 像素高)
 * 总大小: 95 × 16 = 1520 字节
 *
 * 字节排列: [0]~[7] 是字符上半部分 (8行), [8]~[15] 是下半部分 (8行)
 * 每字节的 bit7 对应像素最上面, bit0 对应最下面
 * bit = 1 → 点亮, bit = 0 → 熄灭
 *
 * 【举例】字符 'A' 的 16 字节:
 *   上半 (页0):  0x00,0x00,0xC0,0x38,0xE0,0x00,0x00,0x00
 *                □□□□□□□□
 *                □□□□□□□□
 *                □□■■□□□□
 *                □□□■■■■■
 *                □□■■■□□□
 *                □□□□□□□□
 *                □□□□□□□□
 *                □□□□□□□□
 *   下半 (页1):  0x20,0x3C,0x23,0x01,0x27,0x3C,0x38,0x00
 *                □□■□□□□□
 *                □□■■■■□□
 *                □□■□□□■■
 *                □□□□□□□■
 *                □□■□□■■■
 *                □□■■■■□□
 *                □□■■■□□□
 *                □□□□□□□□
 * ============================================================
 */
static const uint8_t OLED_Font8x16[][16] = {

    /* 32 - ' ' (空格) */
    { 0x00,0x00,0x00,0x00,0x00,0x00,0x00,0x00,
      0x00,0x00,0x00,0x00,0x00,0x00,0x00,0x00 },

    /* 33 - '!' */
    { 0x00,0x00,0x00,0xF8,0x00,0x00,0x00,0x00,
      0x00,0x00,0x00,0x33,0x30,0x00,0x00,0x00 },

    /* 34 - '"' */
    { 0x00,0x10,0x0C,0x06,0x10,0x0C,0x06,0x00,
      0x00,0x00,0x00,0x00,0x00,0x00,0x00,0x00 },

    /* 35 - '#' */
    { 0x40,0xC0,0x78,0x40,0xC0,0x78,0x40,0x00,
      0x04,0x3F,0x04,0x04,0x04,0x3F,0x04,0x00 },

    /* 36 - '$' */
    { 0x00,0x70,0x88,0xFC,0x08,0x30,0x00,0x00,
      0x00,0x18,0x20,0xFF,0x21,0x1E,0x00,0x00 },

    /* 37 - '%' */
    { 0xF0,0x08,0xF0,0x00,0xE0,0x18,0x00,0x00,
      0x00,0x21,0x1C,0x03,0x1E,0x21,0x1E,0x00 },

    /* 38 - '&' */
    { 0x00,0xF0,0x08,0x88,0x70,0x00,0x00,0x00,
      0x1E,0x21,0x23,0x24,0x19,0x27,0x21,0x10 },

    /* 39 - ''' */
    { 0x10,0x16,0x0E,0x00,0x00,0x00,0x00,0x00,
      0x00,0x00,0x00,0x00,0x00,0x00,0x00,0x00 },

    /* 40 - '(' */
    { 0x00,0x00,0x00,0xE0,0x18,0x04,0x02,0x00,
      0x00,0x00,0x00,0x07,0x18,0x20,0x40,0x00 },

    /* 41 - ')' */
    { 0x00,0x02,0x04,0x18,0xE0,0x00,0x00,0x00,
      0x00,0x40,0x20,0x18,0x07,0x00,0x00,0x00 },

    /* 42 - '*' */
    { 0x40,0x40,0x80,0xF0,0x80,0x40,0x40,0x00,
      0x02,0x02,0x01,0x0F,0x01,0x02,0x02,0x00 },

    /* 43 - '+' */
    { 0x00,0x00,0x00,0xF0,0x00,0x00,0x00,0x00,
      0x01,0x01,0x01,0x1F,0x01,0x01,0x01,0x00 },

    /* 44 - ',' */
    { 0x00,0x00,0x00,0x00,0x00,0x00,0x00,0x00,
      0x80,0xB0,0x70,0x00,0x00,0x00,0x00,0x00 },

    /* 45 - '-' */
    { 0x00,0x00,0x00,0x00,0x00,0x00,0x00,0x00,
      0x00,0x01,0x01,0x01,0x01,0x01,0x01,0x01 },

    /* 46 - '.' */
    { 0x00,0x00,0x00,0x00,0x00,0x00,0x00,0x00,
      0x00,0x30,0x30,0x00,0x00,0x00,0x00,0x00 },

    /* 47 - '/' */
    { 0x00,0x00,0x00,0x00,0x80,0x60,0x18,0x04,
      0x00,0x60,0x18,0x06,0x01,0x00,0x00,0x00 },

    /* 48 - '0' */
    { 0x00,0xE0,0x10,0x08,0x08,0x10,0xE0,0x00,
      0x00,0x0F,0x10,0x20,0x20,0x10,0x0F,0x00 },

    /* 49 - '1' */
    { 0x00,0x10,0x10,0xF8,0x00,0x00,0x00,0x00,
      0x00,0x20,0x20,0x3F,0x20,0x20,0x00,0x00 },

    /* 50 - '2' */
    { 0x00,0x70,0x08,0x08,0x08,0x88,0x70,0x00,
      0x00,0x30,0x28,0x24,0x22,0x21,0x30,0x00 },

    /* 51 - '3' */
    { 0x00,0x30,0x08,0x88,0x88,0x48,0x30,0x00,
      0x00,0x18,0x20,0x20,0x20,0x11,0x0E,0x00 },

    /* 52 - '4' */
    { 0x00,0x00,0xC0,0x20,0x10,0xF8,0x00,0x00,
      0x00,0x07,0x04,0x24,0x24,0x3F,0x24,0x00 },

    /* 53 - '5' */
    { 0x00,0xF8,0x08,0x88,0x88,0x08,0x08,0x00,
      0x00,0x19,0x21,0x20,0x20,0x11,0x0E,0x00 },

    /* 54 - '6' */
    { 0x00,0xE0,0x10,0x88,0x88,0x18,0x00,0x00,
      0x00,0x0F,0x11,0x20,0x20,0x11,0x0E,0x00 },

    /* 55 - '7' */
    { 0x00,0x38,0x08,0x08,0xC8,0x38,0x08,0x00,
      0x00,0x00,0x00,0x3F,0x00,0x00,0x00,0x00 },

    /* 56 - '8' */
    { 0x00,0x70,0x88,0x08,0x08,0x88,0x70,0x00,
      0x00,0x1C,0x22,0x21,0x21,0x22,0x1C,0x00 },

    /* 57 - '9' */
    { 0x00,0xE0,0x10,0x08,0x08,0x10,0xE0,0x00,
      0x00,0x00,0x31,0x22,0x22,0x11,0x0F,0x00 },

    /* 58 - ':' */
    { 0x00,0x00,0x00,0xC0,0xC0,0x00,0x00,0x00,
      0x00,0x00,0x00,0x30,0x30,0x00,0x00,0x00 },

    /* 59 - ';' */
    { 0x00,0x00,0x00,0x80,0x00,0x00,0x00,0x00,
      0x00,0x00,0x80,0x60,0x00,0x00,0x00,0x00 },

    /* 60 - '<' */
    { 0x00,0x00,0x80,0x40,0x20,0x10,0x08,0x00,
      0x00,0x01,0x02,0x04,0x08,0x10,0x20,0x00 },

    /* 61 - '=' */
    { 0x40,0x40,0x40,0x40,0x40,0x40,0x40,0x00,
      0x04,0x04,0x04,0x04,0x04,0x04,0x04,0x00 },

    /* 62 - '>' */
    { 0x00,0x08,0x10,0x20,0x40,0x80,0x00,0x00,
      0x00,0x20,0x10,0x08,0x04,0x02,0x01,0x00 },

    /* 63 - '?' */
    { 0x00,0x70,0x48,0x08,0x08,0x08,0xF0,0x00,
      0x00,0x00,0x00,0x30,0x36,0x01,0x00,0x00 },

    /* 64 - '@' */
    { 0xC0,0x30,0xC8,0x28,0xE8,0x10,0xE0,0x00,
      0x07,0x18,0x27,0x24,0x23,0x14,0x0B,0x00 },

    /* 65 - 'A' */
    { 0x00,0x00,0xC0,0x38,0xE0,0x00,0x00,0x00,
      0x20,0x3C,0x23,0x01,0x01,0x27,0x38,0x20 },

    /* 66 - 'B' */
    { 0x08,0xF8,0x88,0x88,0x88,0x70,0x00,0x00,
      0x20,0x3F,0x20,0x20,0x20,0x11,0x0E,0x00 },

    /* 67 - 'C' */
    { 0xC0,0x30,0x08,0x08,0x08,0x08,0x38,0x00,
      0x07,0x18,0x20,0x20,0x20,0x10,0x08,0x00 },

    /* 68 - 'D' */
    { 0x08,0xF8,0x08,0x08,0x08,0x10,0xE0,0x00,
      0x20,0x3F,0x20,0x20,0x20,0x10,0x0F,0x00 },

    /* 69 - 'E' */
    { 0x08,0xF8,0x88,0x88,0xE8,0x08,0x10,0x00,
      0x20,0x3F,0x20,0x20,0x23,0x20,0x18,0x00 },

    /* 70 - 'F' */
    { 0x08,0xF8,0x88,0x88,0xE8,0x08,0x10,0x00,
      0x20,0x3F,0x20,0x00,0x03,0x00,0x00,0x00 },

    /* 71 - 'G' */
    { 0xC0,0x30,0x08,0x08,0x08,0x38,0x00,0x00,
      0x07,0x18,0x20,0x20,0x22,0x1E,0x02,0x00 },

    /* 72 - 'H' */
    { 0x08,0xF8,0x08,0x00,0x00,0x08,0xF8,0x08,
      0x20,0x3F,0x21,0x01,0x01,0x21,0x3F,0x20 },

    /* 73 - 'I' */
    { 0x00,0x08,0x08,0xF8,0x08,0x08,0x00,0x00,
      0x00,0x20,0x20,0x3F,0x20,0x20,0x00,0x00 },

    /* 74 - 'J' */
    { 0x00,0x00,0x08,0x08,0xF8,0x08,0x08,0x00,
      0xC0,0x80,0x80,0x80,0x7F,0x00,0x00,0x00 },

    /* 75 - 'K' */
    { 0x08,0xF8,0x88,0xC0,0x28,0x18,0x08,0x00,
      0x20,0x3F,0x20,0x01,0x26,0x38,0x20,0x00 },

    /* 76 - 'L' */
    { 0x08,0xF8,0x08,0x00,0x00,0x00,0x00,0x00,
      0x20,0x3F,0x20,0x20,0x20,0x20,0x30,0x00 },

    /* 77 - 'M' */
    { 0x08,0xF8,0xF8,0x00,0xF8,0xF8,0x08,0x00,
      0x20,0x3F,0x01,0x3E,0x01,0x3F,0x20,0x00 },

    /* 78 - 'N' */
    { 0x08,0xF8,0x30,0xC0,0x00,0x08,0xF8,0x08,
      0x20,0x3F,0x20,0x00,0x07,0x18,0x3F,0x00 },

    /* 79 - 'O' */
    { 0xE0,0x10,0x08,0x08,0x08,0x10,0xE0,0x00,
      0x0F,0x10,0x20,0x20,0x20,0x10,0x0F,0x00 },

    /* 80 - 'P' */
    { 0x08,0xF8,0x08,0x08,0x08,0x08,0xF0,0x00,
      0x20,0x3F,0x21,0x01,0x01,0x01,0x00,0x00 },

    /* 81 - 'Q' */
    { 0xE0,0x10,0x08,0x08,0x08,0x10,0xE0,0x00,
      0x0F,0x18,0x24,0x24,0x38,0x50,0x4F,0x00 },

    /* 82 - 'R' */
    { 0x08,0xF8,0x88,0x88,0x88,0x88,0x70,0x00,
      0x20,0x3F,0x20,0x00,0x03,0x0C,0x30,0x20 },

    /* 83 - 'S' */
    { 0x00,0x70,0x88,0x08,0x08,0x08,0x38,0x00,
      0x00,0x38,0x20,0x21,0x21,0x22,0x1C,0x00 },

    /* 84 - 'T' */
    { 0x18,0x08,0x08,0xF8,0x08,0x08,0x18,0x00,
      0x00,0x00,0x20,0x3F,0x20,0x00,0x00,0x00 },

    /* 85 - 'U' */
    { 0x08,0xF8,0x08,0x00,0x00,0x08,0xF8,0x08,
      0x00,0x1F,0x20,0x20,0x20,0x20,0x1F,0x00 },

    /* 86 - 'V' */
    { 0x08,0x78,0x88,0x00,0x00,0xC8,0x38,0x08,
      0x00,0x00,0x07,0x38,0x0E,0x01,0x00,0x00 },

    /* 87 - 'W' */
    { 0xF8,0x08,0x00,0xF8,0x00,0x08,0xF8,0x00,
      0x03,0x3C,0x07,0x00,0x07,0x3C,0x03,0x00 },

    /* 88 - 'X' */
    { 0x08,0x18,0x68,0x80,0x80,0x68,0x18,0x08,
      0x20,0x30,0x2C,0x03,0x03,0x2C,0x30,0x20 },

    /* 89 - 'Y' */
    { 0x08,0x38,0xC8,0x00,0xC8,0x38,0x08,0x00,
      0x00,0x00,0x20,0x3F,0x20,0x00,0x00,0x00 },

    /* 90 - 'Z' */
    { 0x10,0x08,0x08,0x08,0xC8,0x38,0x08,0x00,
      0x20,0x38,0x26,0x21,0x20,0x20,0x18,0x00 },

    /* 91 - '[' */
    { 0x00,0x00,0x00,0xFE,0x02,0x02,0x02,0x00,
      0x00,0x00,0x00,0x7F,0x40,0x40,0x40,0x00 },

    /* 92 - '\' */
    { 0x00,0x04,0x18,0x60,0x80,0x00,0x00,0x00,
      0x00,0x00,0x00,0x00,0x01,0x06,0x18,0x60 },

    /* 93 - ']' */
    { 0x00,0x02,0x02,0x02,0xFE,0x00,0x00,0x00,
      0x00,0x40,0x40,0x40,0x7F,0x00,0x00,0x00 },

    /* 94 - '^' */
    { 0x00,0x00,0x04,0x02,0x02,0x02,0x04,0x00,
      0x00,0x00,0x00,0x00,0x00,0x00,0x00,0x00 },

    /* 95 - '_' */
    { 0x00,0x00,0x00,0x00,0x00,0x00,0x00,0x00,
      0x80,0x80,0x80,0x80,0x80,0x80,0x80,0x80 },

    /* 96 - '`' */
    { 0x00,0x02,0x02,0x04,0x00,0x00,0x00,0x00,
      0x00,0x00,0x00,0x00,0x00,0x00,0x00,0x00 },

    /* 97 - 'a' */
    { 0x00,0x00,0x80,0x80,0x80,0x00,0x00,0x00,
      0x00,0x19,0x24,0x22,0x12,0x3F,0x20,0x00 },

    /* 98 - 'b' */
    { 0x08,0xF8,0x00,0x80,0x80,0x00,0x00,0x00,
      0x00,0x3F,0x11,0x20,0x20,0x11,0x0E,0x00 },

    /* 99 - 'c' */
    { 0x00,0x00,0x00,0x80,0x80,0x80,0x00,0x00,
      0x00,0x0E,0x11,0x20,0x20,0x20,0x11,0x00 },

    /* 100 - 'd' */
    { 0x00,0x00,0x00,0x80,0x80,0x88,0xF8,0x00,
      0x00,0x0E,0x11,0x20,0x20,0x10,0x3F,0x20 },

    /* 101 - 'e' */
    { 0x00,0x00,0x80,0x80,0x80,0x80,0x00,0x00,
      0x00,0x1F,0x22,0x22,0x22,0x22,0x13,0x00 },

    /* 102 - 'f' */
    { 0x00,0x80,0x80,0xF0,0x88,0x88,0x88,0x18,
      0x00,0x20,0x20,0x3F,0x20,0x20,0x00,0x00 },

    /* 103 - 'g' */
    { 0x00,0x00,0x80,0x80,0x80,0x80,0x80,0x00,
      0x00,0x6B,0x94,0x94,0x94,0x93,0x60,0x00 },

    /* 104 - 'h' */
    { 0x08,0xF8,0x00,0x80,0x80,0x80,0x00,0x00,
      0x20,0x3F,0x21,0x00,0x00,0x20,0x3F,0x20 },

    /* 105 - 'i' */
    { 0x00,0x80,0x98,0x98,0x00,0x00,0x00,0x00,
      0x00,0x20,0x20,0x3F,0x20,0x20,0x00,0x00 },

    /* 106 - 'j' */
    { 0x00,0x00,0x00,0x80,0x98,0x98,0x00,0x00,
      0x00,0xC0,0x80,0x80,0x80,0x7F,0x00,0x00 },

    /* 107 - 'k' */
    { 0x08,0xF8,0x00,0x00,0x80,0x80,0x80,0x00,
      0x20,0x3F,0x24,0x02,0x2D,0x30,0x20,0x00 },

    /* 108 - 'l' */
    { 0x00,0x08,0x08,0xF8,0x00,0x00,0x00,0x00,
      0x00,0x20,0x20,0x3F,0x20,0x20,0x00,0x00 },

    /* 109 - 'm' */
    { 0x80,0x80,0x80,0x80,0x80,0x80,0x80,0x00,
      0x20,0x3F,0x20,0x00,0x3F,0x20,0x00,0x3F },

    /* 110 - 'n' */
    { 0x80,0x80,0x00,0x80,0x80,0x80,0x00,0x00,
      0x20,0x3F,0x21,0x00,0x00,0x20,0x3F,0x20 },

    /* 111 - 'o' */
    { 0x00,0x00,0x80,0x80,0x80,0x80,0x00,0x00,
      0x00,0x0E,0x11,0x20,0x20,0x11,0x0E,0x00 },

    /* 112 - 'p' */
    { 0x80,0x80,0x00,0x80,0x80,0x00,0x00,0x00,
      0x80,0xFF,0x91,0x20,0x20,0x11,0x0E,0x00 },

    /* 113 - 'q' */
    { 0x00,0x00,0x00,0x80,0x80,0x00,0x80,0x00,
      0x00,0x0E,0x11,0x20,0x20,0x91,0xFF,0x80 },

    /* 114 - 'r' */
    { 0x80,0x80,0x80,0x00,0x80,0x80,0x80,0x00,
      0x20,0x20,0x3F,0x21,0x20,0x00,0x01,0x00 },

    /* 115 - 's' */
    { 0x00,0x00,0x80,0x80,0x80,0x80,0x80,0x00,
      0x00,0x33,0x24,0x24,0x24,0x24,0x19,0x00 },

    /* 116 - 't' */
    { 0x00,0x80,0x80,0xE0,0x80,0x80,0x00,0x00,
      0x00,0x00,0x00,0x1F,0x20,0x20,0x00,0x00 },

    /* 117 - 'u' */
    { 0x80,0x80,0x00,0x00,0x00,0x80,0x80,0x00,
      0x00,0x1F,0x20,0x20,0x20,0x10,0x3F,0x20 },

    /* 118 - 'v' */
    { 0x80,0x80,0x80,0x00,0x00,0x80,0x80,0x80,
      0x00,0x01,0x0E,0x30,0x08,0x06,0x01,0x00 },

    /* 119 - 'w' */
    { 0x80,0x80,0x00,0x80,0x00,0x80,0x80,0x80,
      0x0F,0x30,0x0C,0x03,0x0C,0x30,0x0F,0x00 },

    /* 120 - 'x' */
    { 0x00,0x80,0x80,0x00,0x80,0x80,0x80,0x00,
      0x00,0x20,0x31,0x2E,0x0E,0x31,0x20,0x00 },

    /* 121 - 'y' */
    { 0x80,0x80,0x80,0x00,0x00,0x80,0x80,0x80,
      0x80,0x81,0x8E,0x70,0x18,0x06,0x01,0x00 },

    /* 122 - 'z' */
    { 0x00,0x80,0x80,0x80,0x80,0x80,0x80,0x00,
      0x00,0x21,0x30,0x2C,0x22,0x21,0x30,0x00 },

    /* 123 - '{' */
    { 0x00,0x00,0x00,0x00,0x80,0x7C,0x02,0x02,
      0x00,0x00,0x00,0x00,0x00,0x3F,0x40,0x40 },

    /* 124 - '|' */
    { 0x00,0x00,0x00,0x00,0xFF,0x00,0x00,0x00,
      0x00,0x00,0x00,0x00,0xFF,0x00,0x00,0x00 },

    /* 125 - '}' */
    { 0x00,0x02,0x02,0x7C,0x80,0x00,0x00,0x00,
      0x00,0x40,0x40,0x3F,0x00,0x00,0x00,0x00 },

    /* 126 - '~' */
    { 0x00,0x06,0x01,0x01,0x02,0x02,0x04,0x04,
      0x00,0x00,0x00,0x00,0x00,0x00,0x00,0x00 },

};  /* 共 95 个字符 (ASCII 32 ~ 126) */


/* ============================================================
 * OLED 发送命令字节
 * ------------------------------------------------------------
 * 流程: START → 设备地址(写) → 控制字节(0x00=命令) → 命令 → STOP
 *
 * 【控制字节说明】
 *   0x00 = Co=0, D/C#=0
 *     Co=0: 后面还有字节（这里就一个命令字节）
 *     D/C#=0: 这个字节是【命令】，写入 SSD1306 的命令寄存器
 *
 * 常用命令举例:
 *   0xAE = 关闭显示 (Display OFF / Sleep)
 *   0xAF = 开启显示 (Display ON)
 *   0x81 = 设置对比度（后跟一个对比度值 0~255）
 *   0x20 = 设置内存寻址模式
 * ============================================================ */
static void OLED_WriteCmd(uint8_t cmd)
{
    /* 第1步: 发送起始信号 */
    I2C_GenerateSTART(I2C1, ENABLE);
    while (I2C_CheckEvent(I2C1, I2C_EVENT_MASTER_MODE_SELECT) == ERROR);

    /* 第2步: 发送 OLED 设备地址 + 写方向 */
    I2C_Send7bitAddress(I2C1, OLED_ADDR_WRITE, I2C_Direction_Transmitter);
    while (I2C_CheckEvent(I2C1, I2C_EVENT_MASTER_TRANSMITTER_MODE_SELECTED) == ERROR);

    /* 第3步: 发送控制字节 0x00，告诉 SSD1306 "接下来是命令" */
    I2C_SendData(I2C1, OLED_CTRL_CMD);
    while (I2C_CheckEvent(I2C1, I2C_EVENT_MASTER_BYTE_TRANSMITTED) == ERROR);

    /* 第4步: 发送命令字节本身 */
    I2C_SendData(I2C1, cmd);
    while (I2C_CheckEvent(I2C1, I2C_EVENT_MASTER_BYTE_TRANSMITTED) == ERROR);

    /* 第5步: 发送停止信号 */
    I2C_GenerateSTOP(I2C1, ENABLE);
}

/* ============================================================
 * OLED 发送多个数据字节（写入 GDDRAM 显示缓冲区）
 * ------------------------------------------------------------
 * 流程: START → 设备地址(写) → 控制字节(0x40=数据) → 数据1 → 数据2 → ... → STOP
 *
 * 【控制字节说明】
 *   0x40 = Co=0, D/C#=1
 *     Co=0: 后面还有字节
 *     D/C#=1: 这些字节是【数据】，写入 SSD1306 的 GDDRAM
 *             每个 bit 直接对应屏幕上一个像素的亮灭
 *
 * 【连续写入】
 *   每写一个字节，SSD1306 内部列地址自动 +1
 *   写完一列后光标自动移到下一列
 *   写完最后一列 (127) 后自动回到第 0 列
 *
 *   pData: 指向数据缓冲区的指针
 *   len:   要发送的字节数
 * ============================================================ */
static void OLED_WriteData(const uint8_t *pData, uint8_t len)
{
    /* 第1步: 发送起始信号 */
    I2C_GenerateSTART(I2C1, ENABLE);
    while (I2C_CheckEvent(I2C1, I2C_EVENT_MASTER_MODE_SELECT) == ERROR);

    /* 第2步: 发送 OLED 设备地址 + 写方向 */
    I2C_Send7bitAddress(I2C1, OLED_ADDR_WRITE, I2C_Direction_Transmitter);
    while (I2C_CheckEvent(I2C1, I2C_EVENT_MASTER_TRANSMITTER_MODE_SELECTED) == ERROR);

    /* 第3步: 发送控制字节 0x40，告诉 SSD1306 "接下来是显示数据" */
    I2C_SendData(I2C1, OLED_CTRL_DATA);
    while (I2C_CheckEvent(I2C1, I2C_EVENT_MASTER_BYTE_TRANSMITTED) == ERROR);

    /* 第4步: 连续发送数据字节，每发一个 SSD1306 列地址自动 +1 */
    while (len--)
    {
        I2C_SendData(I2C1, *pData++);
        while (I2C_CheckEvent(I2C1, I2C_EVENT_MASTER_BYTE_TRANSMITTED) == ERROR);
    }

    /* 第5步: 发送停止信号 */
    I2C_GenerateSTOP(I2C1, ENABLE);
}

/* ============================================================
 * 设置光标位置
 * ------------------------------------------------------------
 * 在页寻址模式下，通过设置页地址和列地址来定位光标
 *
 * page: 页号 (0~7)，每页 8 像素高
 *       使用 8×16 字体时: 偶数页 = 字符上半部分, 奇数页 = 下半部分
 * col:  列号 (0~127)，像素级定位
 *       使用 8×16 字体时: 每字符占 8 列，col 应为 8 的整数倍
 * ============================================================ */
static void OLED_SetCursor(uint8_t page, uint8_t col)
{
    /* 设置页地址 (0xB0~0xB7 对应 Page 0~7) */
    OLED_WriteCmd(0xB0 | page);

    /* 设置列地址低 4 位 (0x00~0x0F) */
    OLED_WriteCmd(0x00 | (col & 0x0F));

    /* 设置列地址高 4 位 (0x10~0x1F) */
    OLED_WriteCmd(0x10 | ((col >> 4) & 0x0F));
}

/* ============================================================
 * OLED 初始化
 * ------------------------------------------------------------
 * 使用前必须调用，配置 SSD1306 的所有工作参数。
 *
 * 【前提条件】
 *   必须先调用 I2C_MyInit() 初始化 I2C1 外设！
 *   推荐顺序: I2C_MyInit() → MPU6050_Init() → OLED_Init()
 *   这样 I2C1 和 MPU6050 都准备好了，OLED 直接使用 I2C1 即可。
 *
 * 【初始化步骤说明】
 *   SSD1306 上电后处于复位状态，需要按特定顺序发送命令
 *   才能正常显示。以下步骤按数据手册推荐顺序排列。
 * ============================================================ */
void OLED_Init(void)
{
    /*
     * 上电后 SSD1306 需要一段稳定时间
     * 实际测试中 100ms 足够（和 MPU6050 类似）
     */

    OLED_WriteCmd(0xAE);    /* 1. 关闭显示 — 初始化过程中先关掉，配置完再开 */

    OLED_WriteCmd(0xD5);    /* 2. 设置显示时钟分频/振荡频率 */
    OLED_WriteCmd(0x80);    /*
                             *    分频比 = 1, 频率 = 8 (默认值)
                             *    [7:4] = 振荡频率 (0~F, 值越大越快)
                             *    [3:0] = 时钟分频 (1~16)
                             */

    OLED_WriteCmd(0xA8);    /* 3. 设置多路复用比 (MUX Ratio) */
    OLED_WriteCmd(0x3F);    /*
                             *    MUX = 63+1 = 64 → 64 行 (对应 128×64 分辨率)
                             *    如果是 128×32 屏幕，这里要设为 0x1F
                             */

    OLED_WriteCmd(0xD3);    /* 4. 设置显示偏移 (Display Offset) */
    OLED_WriteCmd(0x00);    /*    偏移 = 0, 从第一行开始 */

    OLED_WriteCmd(0x40);    /* 5. 设置显示起始行 (Start Line = 0) */

    OLED_WriteCmd(0x8D);    /* 6. 使能电荷泵 (Charge Pump) */
    OLED_WriteCmd(0x14);    /*
                             *    SSD1306 需要内部升压来驱动 OLED 面板
                             *    0x14 = 使能电荷泵 (0x10 = 关闭)
                             *    外部供电 3.3V, 内部升压到 ~7.5V 供面板使用
                             */

    OLED_WriteCmd(0x20);    /* 7. 设置内存寻址模式 (Memory Addressing Mode) */
    OLED_WriteCmd(0x02);    /*
                             *    0x00 = 水平寻址
                             *    0x01 = 垂直寻址
                             *    0x02 = 页寻址 (Page Addressing) — 我们选这个
                             *    页寻址模式下: 设置 Page + Column, 写数据时
                             *    Column 自动递增, 到 127 后回到 0, Page 不变
                             */

    OLED_WriteCmd(0xA1);    /* 8. 段重映射 (Segment Re-map) */
                            /*    0xA0 = 列 0 对应屏幕最左 (正常)
                             *    0xA1 = 列 127 对应屏幕最左 (左右镜像)
                             *    设为 0xA1 使得列 0 在左边 */

    OLED_WriteCmd(0xC8);    /* 9. COM 输出扫描方向 (COM Scan Direction) */
                            /*    0xC0 = 从上到下扫描 (正常)
                             *    0xC8 = 从下到上扫描 (上下镜像)
                             *    设为 0xC8 使得行 0 在最上面 */

    OLED_WriteCmd(0xDA);    /* 10. 设置 COM 引脚硬件配置 */
    OLED_WriteCmd(0x12);    /*
                             *     [7:5] 保留
                             *     [4]   COM 左右映射: 1=交替, 0=顺序 (设1)
                             *     [3:0] COM 引脚配置: 0x02=顺序, 0x12=交替
                             *     128×64 屏幕通常用 0x12 */

    OLED_WriteCmd(0x81);    /* 11. 设置对比度 (Contrast) */
    OLED_WriteCmd(0xCF);    /*     对比度值 0~255, 默认 0x7F, 0xCF 是典型推荐值 */

    OLED_WriteCmd(0xD9);    /* 12. 设置预充电周期 (Pre-charge Period) */
    OLED_WriteCmd(0xF1);    /*
                             *     [7:4] = Phase 2 周期
                             *     [3:0] = Phase 1 周期
                             *     0xF1 是数据手册推荐的典型值 */

    OLED_WriteCmd(0xDB);    /* 13. 设置 VCOMH 电压 (VCOMH Deselect Level) */
    OLED_WriteCmd(0x40);    /*     调节 VCOMH 的电压等级, 0x40 是典型值 (~0.77×VCC) */

    OLED_WriteCmd(0xA4);    /* 14. 全屏显示关闭 (Entire Display ON) */
                            /*     0xA4 = 正常显示 (只显示 GDDRAM 中有数据的位置)
                             *     0xA5 = 全屏点亮 (忽略 GDDRAM, 用于测试) */

    OLED_WriteCmd(0xA6);    /* 15. 设置显示模式 */
                            /*     0xA6 = 正常显示 (1=亮, 0=灭)
                             *     0xA7 = 反色显示 (1=灭, 0=亮, 即黑底白字变白底黑字) */

    OLED_WriteCmd(0xAF);    /* 16. 开启显示 — 屏幕开始工作! */
}

/* ============================================================
 * 清屏 — 将整屏幕填充为黑色（所有像素熄灭）
 * ------------------------------------------------------------
 * 原理: 遍历所有 8 页，每页从列 0 到 127 写入 0x00
 * 0x00 = 该列 8 个像素全部熄灭
 * ============================================================ */
void OLED_Clear(void)
{
    uint8_t page, col;

    /*
     * 只需将缓冲区全部填 0，不操作 I2C
     * 屏幕的实际清屏在 OLED_Refresh() 调用时才生效
     */
    for (page = 0; page < OLED_PAGES; page++)
    {
        for (col = 0; col < OLED_WIDTH; col++)
        {
            OLED_Buffer[page][col] = 0x00;
        }
    }
}

/* ============================================================
 * 刷新屏幕 — 将显示缓冲区一次性推送到 OLED
 * ------------------------------------------------------------
 * 【这是消除屏幕闪烁的关键函数!】
 *
 * 工作原理:
 *   1. 在此之前, 所有绘制函数 (Clear, ShowChar, ShowString 等)
 *      只修改了 SRAM 中的 OLED_Buffer[], 屏幕内容不变
 *   2. 调用本函数时, 遍历全部 8 页, 每页 128 字节连续写入 OLED
 *   3. 整屏数据在约 10~15ms 内全部更新完毕, 肉眼看不到闪烁
 *
 * 调用时机:
 *   在 main 循环中, 完成所有绘制操作后调用一次:
 *     OLED_ShowMPU6050(&data);   // 写缓冲区
 *     OLED_Refresh();             // 推送到屏幕
 *
 * 性能估算 (I2C 100kHz):
 *   1024 字节 × 9 位/字节 ≈ 9216 位
 *   9216 位 / 100000 Hz ≈ 92ms
 *
 *   实际会比 92ms 快一些, 因为 START/STOP/ACK 不计入数据位
 *   但仍然建议不要每 10ms 刷新一次 (没必要, 人眼看不出)
 *   推荐刷新间隔: 100~200ms
 * ============================================================ */
void OLED_Refresh(void)
{
    uint8_t page;

    for (page = 0; page < OLED_PAGES; page++)
    {
        /* 设置光标: 第 page 页, 第 0 列开始 */
        OLED_SetCursor(page, 0);

        /* 将该页的 128 字节一次性写入 OLED 的 GDDRAM */
        OLED_WriteData(OLED_Buffer[page], OLED_WIDTH);
    }
}

/* ============================================================
 * 清除指定行
 * ------------------------------------------------------------
 * 使用 8×16 字体时，每行占 2 页（上半页 + 下半页）
 * row: 行号 0~3（对应 4 行文字）
 *
 *   row=0 → Page 0+1   (屏幕最上面)
 *   row=1 → Page 2+3
 *   row=2 → Page 4+5
 *   row=3 → Page 6+7   (屏幕最下面)
 * ============================================================ */
void OLED_ClearLine(uint8_t row)
{
    uint8_t startPage, i, col;

    if (row >= OLED_MAX_ROW) return;    // 行号越界保护

    startPage = row * 2;                // 每行占 2 页

    /*
     * 只需将缓冲区中该行的两页填 0
     * 屏幕更新延迟到 OLED_Refresh() 时一次性完成
     */
    for (i = 0; i < 2; i++)
    {
        for (col = 0; col < OLED_WIDTH; col++)
        {
            OLED_Buffer[startPage + i][col] = 0x00;
        }
    }
}

/* ============================================================
 * 在指定位置显示一个字符 (8×16 像素)
 * ------------------------------------------------------------
 * row: 行号 (0~3)
 * col: 列号 (0~15)，即第几个字符位置
 * ch:  要显示的 ASCII 字符 (支持 32~126)
 *
 * 【显示原理】
 *   8×16 字体每个字符分上下两部分，各 8 字节:
 *     - 上半部分 (字符数据的 [0]~[7]): 写入 Page(row*2)
 *     - 下半部分 (字符数据的 [8]~[15]): 写入 Page(row*2 + 1)
 *
 *   每字节的 8 个 bit 对应一列中 8 个像素的亮灭
 *   8 字节 × 8 像素高 = 8×8 = 半页像素
 * ============================================================ */
void OLED_ShowChar(uint8_t row, uint8_t col, char ch)
{
    uint8_t page, colAddr, i;
    const uint8_t *pFont;

    if (row >= OLED_MAX_ROW || col >= OLED_MAX_COL) return;   // 越界保护

    if (ch < 32 || ch > 126) ch = ' '; // 不可打印字符替换为空格

    page    = row * 2;                 // 该行的上半页 (Page)
    colAddr = col * OLED_CHAR_WIDTH;   // 像素级列地址 (0, 8, 16, ...)
    pFont   = OLED_Font8x16[ch - 32];  // 字体数据指针

    /*
     * 将 16 字节的 8×16 字体数据写入显示缓冲区
     *   pFont[0]~[7]   → 上半页 (Page)
     *   pFont[8]~[15]  → 下半页 (Page + 1)
     *
     * 不操作 I2C! 只在 SRAM 中修改缓冲区,
     * 等 OLED_Refresh() 被调用时再统一推到屏幕
     */
    for (i = 0; i < 8; i++)
    {
        OLED_Buffer[page][colAddr + i]     = pFont[i];       // 上半部分
        OLED_Buffer[page + 1][colAddr + i] = pFont[i + 8];   // 下半部分
    }
}

/* ============================================================
 * 在指定位置显示字符串
 * ------------------------------------------------------------
 * 从 (row, col) 开始逐个显示字符，遇到 '\0' 结束
 * 不会自动换行，超出 16 列的部分会被截断
 *
 * row: 行号 (0~3)
 * col: 起始列号 (0~15)
 * str: 要显示的字符串（以 '\0' 结尾）
 * ============================================================ */
void OLED_ShowString(uint8_t row, uint8_t col, const char *str)
{
    while (*str != '\0' && col < OLED_MAX_COL)
    {
        OLED_ShowChar(row, col, *str);
        str++;
        col++;
    }
}

/* ============================================================
 * 在指定位置显示有符号整数
 * ------------------------------------------------------------
 * 将 int16_t 数值转换为 "-32768" ~ "+32767" 格式显示
 * 自动对齐到 7 字符宽度 (符号 + 最多 5 位数字)
 *
 * row: 行号 (0~3)
 * col: 起始列号 (0~15)
 * num: 要显示的整数
 * ============================================================ */
void OLED_ShowInt(uint8_t row, uint8_t col, int16_t num)
{
    char buf[8];    // 最宽: "+32767" = 6字符 + '\0' = 7字节, 8字节足够
    uint8_t sign;
    uint8_t digits[5];
    uint8_t i, pos;

    /* --- 第1步: 处理符号 --- */
    if (num < 0)
    {
        sign = '-';
        num  = -num;
    }
    else
    {
        sign = '+';
    }
    /* num 现在是非负数 0~32767（注意: -32768 取反后会溢出!） */
    /* 修正: 如果 num 是 -32768, -(-32768) = -32768 (补码溢出), 特殊处理 */
    /* 实际上 C 语言中 -32768 的 int16_t 取反行为是未定义的, 我们转为 uint16_t 处理 */
    {
        uint16_t absVal;
        if (num < 0)
        {
            /* 这是 -32768 的特殊情况, 上面 -num 失败了 */
            absVal = (uint16_t)(-((int32_t)num));  // 用 int32_t 做强转避免溢出
        }
        else
        {
            absVal = (uint16_t)num;
        }

        /* --- 第2步: 提取各位数字 (从低位到高位) --- */
        pos = 0;
        do
        {
            digits[pos++] = absVal % 10;   // 取最低位
            absVal /= 10;                  // 去掉最低位
        } while (absVal > 0 && pos < 5);
    }
    /* 现在 digits[0] 是个位, digits[1] 是十位, ..., pos 是位数 */

    /* --- 第3步: 格式化为字符串，右对齐，总宽度固定 7 --- */
    /*
     * 格式: "SXXDDDDD" 其中 S=符号, XX=前导空格
     * 例如: +    0 → "+    0"  (6个字符)
     *       +  123 → "+  123"
     *       -32768 → "-32768"
     *
     * 策略: 符号固定占1位, 数字最多5位右对齐, 不够的填空格
     */

    i = 0;
    buf[i++] = sign;                    // 位置0: 符号

    /* 前导空格: 5 - pos 个空格 */
    while (i <= (5 - pos))              // 如果数字有3位, i=1到2填2个空格
    {
        buf[i++] = ' ';
    }

    /* 填入数字 (从高位到低位, 即 digits 数组的逆序) */
    {
        int8_t d = pos - 1;             // pos-1 是最高位索引
        while (d >= 0 && i < 7)
        {
            buf[i++] = '0' + digits[d]; // 数字转 ASCII
            d--;
        }
    }
    buf[i] = '\0';

    /* --- 第4步: 显示字符串 --- */
    OLED_ShowString(row, col, buf);
}

/* ============================================================
 * 在指定位置显示浮点数 (±XXX.X)
 * ------------------------------------------------------------
 * 将 float 值转换为 "±XXX.X" 格式 (6 字符) 显示
 * 范围: -999.9 ~ +999.9，超出范围显示 "+OVF" / "-OVF"
 *
 * row: 行号 (0~3)
 * col: 起始列号 (0~15)
 * num: 要显示的浮点数
 *
 * 示例:
 *   12.34  → "+012.3"
 *   -5.67  → "-005.7"
 *   0.0    → "+000.0"
 *   -1000  → "-OVF"
 * ============================================================ */
void OLED_ShowFloat(uint8_t row, uint8_t col, float num)
{
    char   buf[7];                      // "±XXX.X" = 6字符 + '\0'
    int16_t intPart;                    // 整数部分 × 10（保一位小数）
    uint8_t sign;
    uint8_t i;

    /* --- 越界检查 --- */
    if (num > 999.9f)
    {
        OLED_ShowString(row, col, "+OVF  ");
        return;
    }
    if (num < -999.9f)
    {
        OLED_ShowString(row, col, "-OVF  ");
        return;
    }

    /* --- 符号 --- */
    if (num < 0)
    {
        sign = '-';
        num  = -num;
    }
    else
    {
        sign = '+';
    }

    /*
     * 保留一位小数: 乘以 10 后取整
     *   12.34 × 10 = 123.4 → 取整 123
     *   显示: 整数部分 = 123 / 10 = 12
     *         小数部分 = 123 % 10 = 3
     *         → "+012.3"
     */
    intPart = (int16_t)(num * 10.0f + 0.5f);   // +0.5 四舍五入

    i = 0;
    buf[i++] = sign;                            // 位置0: 符号

    /* 百位 */
    if (intPart >= 1000) buf[i++] = '0' + (intPart / 1000) % 10;
    else                 buf[i++] = '0';

    /* 十位 */
    if (intPart >= 100)  buf[i++] = '0' + (intPart / 100) % 10;
    else                 buf[i++] = '0';

    /* 个位 */
    if (intPart >= 10)   buf[i++] = '0' + (intPart / 10) % 10;
    else                 buf[i++] = '0';

    buf[i++] = '.';                             // 小数点

    /* 小数位 */
    buf[i++] = '0' + (intPart % 10);

    buf[i] = '\0';

    OLED_ShowString(row, col, buf);
}

/* ============================================================
 * 显示 MPU6050 全部传感器数据
 * ------------------------------------------------------------
 * 在 OLED 上以 4 行布局显示所有 6 个数据:
 *
 *   Line 1 (Page 0-1): "~~ MPU6050 DATA ~~"  (标题)
 *   Line 2 (Page 2-3): "AX:+1234  AY:+1234"  (加速度 X, Y)
 *   Line 3 (Page 4-5): "AZ:+1234  GX:+1234"  (加速度 Z, 陀螺仪 X)
 *   Line 4 (Page 6-7): "GY:+1234  GZ:+1234"  (陀螺仪 Y, Z)
 *
 * 每行 2 组数据, 每组 7 字符 (标签+符号+4位数字)
 * 组间 2 空格, 总计 7+2+7 = 16 字符, 刚好填满一行
 *
 * 【为什么只显示 4 位数?】
 *   int16_t 最大 32767, 有 5 位数字。但 128 像素的屏幕上
 *   用 8×16 字体一行只有 16 字符, 放两组 7 字符数据刚好。
 *   如果想看完整 5 位数, 可以把每组数据宽度改为 8 字符,
 *   但需要调整布局。当前 4 位数对大多数传感器读数已经足够。
 *
 * pData: 指向 MPU6050_Data 结构体的指针
 * ============================================================ */
void OLED_ShowMPU6050(MPU6050_Data *pData)
{
    /* --- Line 1: 标题 --- */
    OLED_ShowString(0, 0, "~~ MPU6050 DATA ~~");

    /* --- Line 2: 加速度 X + Y --- */
    OLED_ClearLine(1);                  // 先清空该行
    OLED_ShowString(1, 0, "AX:");
    OLED_ShowInt(1, 3, pData->Accel_X);
    OLED_ShowString(1, 9, "AY:");
    OLED_ShowInt(1, 12, pData->Accel_Y);

    /* --- Line 3: 加速度 Z + 陀螺仪 X --- */
    OLED_ClearLine(2);
    OLED_ShowString(2, 0, "AZ:");
    OLED_ShowInt(2, 3, pData->Accel_Z);
    OLED_ShowString(2, 9, "GX:");
    OLED_ShowInt(2, 12, pData->Gyro_X);

    /* --- Line 4: 陀螺仪 Y + Z --- */
    OLED_ClearLine(3);
    OLED_ShowString(3, 0, "GY:");
    OLED_ShowInt(3, 3, pData->Gyro_Y);
    OLED_ShowString(3, 9, "GZ:");
    OLED_ShowInt(3, 12, pData->Gyro_Z);
}
